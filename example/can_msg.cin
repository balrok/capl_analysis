/*@!Encoding:1252*/

includes
{
}



variables {
}

on message * {
  if (this.id >= 0x100 && this.id <= 0x100+(10*0x10)+10) { // cmd to server
      write("STATUS - %d", this.id);
  }
  test_capl_msg(this);
}

void test_capl_msg(message * msg) {
  msg.id = 0x0200;  // broadcast id
  msg.dlc = 6;
  msg.byte(0) = 1;
  msg.byte(1) = 2;
  msg.byte(2) = 3;
  msg.byte(3) = 4;
  msg.word(4) = 5;
  output(msg);
}
